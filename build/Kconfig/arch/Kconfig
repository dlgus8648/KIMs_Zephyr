## build/Kconfig/arch/Kconfig
```kconfig
# Load Zephyr Arch Kconfig descriptions.
osource "/home/kimrihyeon/zephyrproject/zephyr/arch/x86/Kconfig"
osource "/home/kimrihyeon/zephyrproject/zephyr/arch/xtensa/Kconfig"
osource "/home/kimrihyeon/zephyrproject/zephyr/arch/sparc/Kconfig"
osource "/home/kimrihyeon/zephyrproject/zephyr/arch/riscv/Kconfig"
osource "/home/kimrihyeon/zephyrproject/zephyr/arch/posix/Kconfig"
osource "/home/kimrihyeon/zephyrproject/zephyr/arch/nios2/Kconfig"
osource "/home/kimrihyeon/zephyrproject/zephyr/arch/mips/Kconfig"
osource "/home/kimrihyeon/zephyrproject/zephyr/arch/arm64/Kconfig"
osource "/home/kimrihyeon/zephyrproject/zephyr/arch/arm/Kconfig"
osource "/home/kimrihyeon/zephyrproject/zephyr/arch/arc/Kconfig"
```

## build/Kconfig/boards/Kconfig.defconfig
```kconfig
# Load Zephyr board defconfig descriptions.
osource "/home/kimrihyeon/zephyrproject/zephyr/boards/st/nucleo_f411re/Kconfig.defconfig"
```

## build/Kconfig/boards/Kconfig.nucleo_f411re
```kconfig
# Load board Kconfig descriptions.
osource "/home/kimrihyeon/zephyrproject/zephyr/boards/st/nucleo_f411re/Kconfig.nucleo_f411re"
```
